#include "falange.dtsi"

&default_transform {
    col-offset = <5>;
};

&kscan0 {
    col-gpios
        = <&pro_micro 10 GPIO_ACTIVE_HIGH> // col1 in the schematic
        , <&pro_micro 16 GPIO_ACTIVE_HIGH> // col1 in the schematic
        , <&pro_micro 14 GPIO_ACTIVE_HIGH> // col1 in the schematic
        , <&pro_micro 7  GPIO_ACTIVE_HIGH> // col1 in the schematic
        , <&pro_micro 9  GPIO_ACTIVE_HIGH> // col1 in the schematic
        ;
};

pro_micro_i2c: &i2c0 {};
&i2c0 {
    status = "okay";
    compatible = "nordic,nrf-twi";
    pinctrl-0 = <&i2c0_default>;
    pinctrl-1 = <&i2c0_sleep>;
    pinctrl-names = "default", "sleep";

    oled: ssd1306@3c {
        compatible = "solomon,ssd1306fb";
        reg = <0x3c>;
        width = <128>;
        height = <32>;
        segment-offset = <0>;
        page-offset = <0>;
        display-offset = <0>;
        multiplex-ratio = <31>;
        com-sequential;
        inversion-on;
        prechargep = <0x22>;
    };
};
