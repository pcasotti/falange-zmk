## boards/shields/falange-taipo/Kconfig.shield
```kconfig
config SHIELD_FALANGE_LEFT
    def_bool $(shields_list_contains,falange-taipo_left)

config SHIELD_FALANGE_RIGHT
    def_bool $(shields_list_contains,falange-taipo_right)
```

## boards/shields/falange/Kconfig.defconfig
```kconfig
if SHIELD_FALANGE_LEFT

config ZMK_KEYBOARD_NAME
    default "Falange"

config ZMK_SPLIT_ROLE_CENTRAL
    default y

config ZMK_DISPLAY_STATUS_SCREEN_CUSTOM
    select LV_USE_LABEL
    select LV_USE_IMG
    select LV_USE_CANVAS
    select LV_USE_ANIMIMG 
    select LV_USE_ANIMATION
    select LV_USE_LINE 
    select LV_FONT_UNSCII_8
    select ZMK_WPM
    imply ZMK_HID_INDICATORS

choice ZMK_DISPLAY_WORK_QUEUE
    default ZMK_DISPLAY_WORK_QUEUE_DEDICATED
endchoice

endif

if SHIELD_FALANGE_RIGHT

config ZMK_DISPLAY_STATUS_SCREEN_CUSTOM
    select LV_USE_LABEL
    select LV_USE_IMG
    select LV_USE_CANVAS
    select LV_USE_ANIMIMG 
    select LV_USE_ANIMATION
    select LV_USE_LINE 
    select LV_FONT_UNSCII_8

choice ZMK_DISPLAY_WORK_QUEUE
    default ZMK_DISPLAY_WORK_QUEUE_DEDICATED
endchoice

endif

if SHIELD_FALANGE_LEFT || SHIELD_FALANGE_RIGHT

choice ZMK_DISPLAY_STATUS_SCREEN
    default ZMK_DISPLAY_STATUS_SCREEN_CUSTOM
endchoice

config ZMK_SPLIT_BLE_CENTRAL_BATTERY_LEVEL_FETCHING
    default y

config ZMK_BATTERY_REPORTING
    default y

config ZMK_SPLIT
    default y

if ZMK_DISPLAY

config I2C
    default y

config SSD1306
    default y

endif # ZMK_DISPLAY

if LVGL

config LV_Z_MEM_POOL_SIZE
    default 8192

config LV_Z_VDB_SIZE
    default 64

config LV_DPI_DEF
    default 148

config LV_Z_BITS_PER_PIXEL
    default 1

choice LV_COLOR_DEPTH
    default LV_COLOR_DEPTH_1
endchoice

endif # LVGL

endif
```

## boards/shields/falange/falange_defconfig
```kconfig
CONFIG_GPIO=y
CONFIG_PINCTRL=y
CONFIG_ZMK_DISPLAY=y
CONFIG_ZMK_DISPLAY_INVERT=y
CONFIG_ZMK_WIDGET_BATTERY_STATUS_SHOW_PERCENTAGE=y
CONFIG_ZMK_WIDGET_OUTPUT_STATUS=y
CONFIG_ZMK_SPLIT_BLE_CENTRAL_BATTERY_LEVEL_FETCHING=y
```
